#include "candle.h"
#include <Arduino.h>
#include <stdio.h>
#include "common.h"
#include "gravity.h"

// 柏林噪声的种子序列， 257个元素，最后一个防溢出
static  uint8_t perm[] PROGMEM = {
    151, 160, 137, 91, 90, 10,
    131, 13, 201, 95, 96, 53, 194, 233, 7, 225, 140, 36, 103, 30, 69, 142, 8, 99, 37, 240, 21, 10, 23,
    190, 6, 148, 247, 120, 234, 75, 0, 26, 197, 62, 94, 252, 219, 203, 117, 35, 11, 32, 57, 177, 33,
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    138, 236, 205, 93, 222, 114, 67, 29, 24, 72, 243, 141, 128, 195, 78, 66, 215, 61, 156, 180, 151};

// t*t*t*(t*(t*6-15)+10
static uint8_t smooth_lut[] PROGMEM = {
    0x00, 0x00, 0x00, 0x00, 0x00, 0x00, 0x00, 0x00, 0x00, 0x00, 0x00, 0x00, 0x00, 0x00, 0x00, 0x00,
    0x01, 0x01, 0x01, 0x01, 0x01, 0x01, 0x01, 0x02, 0x02, 0x02, 0x02, 0x03, 0x03, 0x03, 0x03, 0x04,
    0x04, 0x05, 0x05, 0x05, 0x06, 0x06, 0x07, 0x07, 0x08, 0x08, 0x09, 0x09, 0x0A, 0x0B, 0x0B, 0x0C,
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    0xFF, 0xFF, 0xFF, 0xFF, 0xFF, 0xFF, 0xFF, 0xFF, 0xFF, 0xFF, 0xFF, 0xFF, 0xFF, 0xFF, 0xFF, 0xFF};

static uint8_t candle_width = 15;
static uint8_t candle_height = 32;
static uint8_t candle[32][15] = {
    {0x08, 0x09, 0x0C, 0x14, 0x22, 0x2F, 0x36, 0x38, 0x36, 0x2F, 0x22, 0x14, 0x0C, 0x09, 0x08},
    {0x09, 0x0B, 0x11, 0x1E, 0x32, 0x45, 0x51, 0x54, 0x51, 0x45, 0x32, 0x1E, 0x11, 0x0B, 0x09},
    {0x0A, 0x0E, 0x19, 0x2C, 0x46, 0x5F, 0x71, 0x76, 0x71, 0x5F, 0x46, 0x2C, 0x19, 0x0E, 0x0A},
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    {0x08, 0x0A, 0x0D, 0x11, 0x15, 0x1A, 0x1D, 0x1D, 0x1D, 0x1A, 0x15, 0x11, 0x0D, 0x0A, 0x08}
};

//

// 平滑插值函数
static int8_t lerp(uint8_t t, int8_t a, int8_t b)
{
    return ((int16_t)a * (256 - t) + (int16_t)b * t) / 256;
}

// 二维柏林噪声梯度hash函数
static int8_t grad(uint8_t hash, int8_t x, int8_t y)
{
    return ((hash & 1) == 0 ? x : -x) + ((hash & 2) == 0 ? y : -y);
}

// 2维柏林噪声函数，t/256决定下标，t%256用来插值, t是x或y
// 返回值范围是[0, 255]
static uint8_t perlin_noise(uint16_t x, uint16_t y)
{
    uint8_t X = x >> 8;
    uint8_t Y = y >> 8;
    int8_t fx1 = (uint8_t)x >> 2;
    int8_t fy1 = (uint8_t)y >> 2;
    int8_t fx2 = fx1 - 64;
    int8_t fy2 = fy1 - 64;

    uint8_t u = smooth_lut[(uint8_t)x];
    uint8_t v = smooth_lut[(uint8_t)y];
    uint8_t A = perm[X] + Y;
    uint8_t B = perm[X + 1] + Y;

    // printf("X=%d, Y=%d, fx1 = %d, fy1 = %d, fx2 = %d, fy2 = %d, u = %d, v = %d, A = %d, B = %d",
    // X, Y, fx1, fy1, fx2, fy2, u, v, A, B);

    int8_t result = lerp(v, lerp(u, grad(perm[A], fx1, fy1), grad(perm[B], fx2, fy1)),
                lerp(u, grad(perm[A + 1], fx1, fy2), grad(perm[B + 1], fx2, fy2)));

    return (uint8_t)result + 128;
}

uint8_t candle_sample(uint8_t u, uint8_t v)
{
    uint16_t uu = u * (candle_width - 1);
    uint8_t X = uu >> 8;
    uint8_t x = uu;

    uint16_t vv = v * (candle_height - 1);
    uint8_t Y = vv >> 8;
    uint8_t y = vv;

    uint8_t a = ((uint16_t)candle[Y][X] * (256 - x) + (uint16_t)candle[Y][X + 1] * x) >> 8;
    uint8_t b = ((uint16_t)candle[Y + 1][X] * (256 - x) + (uint16_t)candle[Y + 1][X + 1] * x) >> 8;
    uint8_t c = ((uint16_t)a * (256 - y) + (uint16_t)b * y) >> 8;

    return c;
}

uint8_t candle_flicker_wind_sharp(
    uint8_t u, uint8_t v,
    uint32_t t,
    int8_t wind_x,
    int8_t wind_y,
    uint8_t turbulence,
    uint8_t size
)
{
    uint8_t height = v;
    uint8_t base0 = candle_sample(u, v);
    uint8_t edge_threshold = 20;

    if (base0 < edge_threshold)
        return 0;

    uint8_t local_turb = (uint16_t)base0 * turbulence / 255;
    int16_t u_wind = (int16_t)wind_x * height / 255;
    int16_t v_wind = (int16_t)wind_y * height / 255;

    uint8_t noise = perlin_noise(u + t/15, v + t/10);

    int16_t u_noise = ((int16_t)noise - 128) * local_turb / 64;
    int16_t v_noise = ((int16_t)noise - 128) * local_turb / 128;

    int16_t uu = u + u_wind + u_noise;
    int16_t vv = v + v_wind + v_noise;

    int16_t shrink = height * 40 / 255;
    uu = (uu - 128) * (64 - shrink) / 64 + 128;

    uu = (uu - 128) * 72 / size + 128;
    vv = (vv - 192) * 48 / size + 192;

    if (uu < 0) uu = 0;
    if (uu > 255) uu = 255;
    if (vv < 0) vv = 0;
    if (vv > 255) vv = 255;

    uint8_t base = candle_sample(uu, vv);
    base = (base * base) >> 8;

    uint8_t fade = 255 - (height > 180 ? (height - 180) * 3 : 0);
    if (fade > 255) fade = 0;

    uint16_t val = (uint16_t)base * fade / 255;
    return val;
}

static CRGB candle_colorize(uint8_t value, uint8_t theme_hue)
{
    if (value == 0) {
        return CRGB::Black;
    }

    uint8_t hot = scale8(value, value);
    CRGB outer = CHSV(theme_hue, 255, value);
    CRGB mid = CHSV(theme_hue + 10, 220, qadd8(value, 24));
    CRGB core = CHSV(theme_hue + 20, 100, qadd8(hot, 52));
    CRGB white = CHSV(theme_hue + 26, 12, qadd8(hot, 28));

    CRGB c = outer;
    if (value > 70) {
        uint8_t mix1 = scale8(value - 70, 170);
        c = blend(c, mid, mix1);
    }
    if (value > 120) {
        uint8_t mix2 = scale8(value - 120, 210);
        c = blend(c, core, mix2);
    }
    if (value > 155) {
        uint8_t mix3 = scale8(value - 155, 255);
        c = blend(c, white, mix3);
    }

    return c;
}

float t = 0;
uint32_t last_ms = 0;
int mem_subindex3=-1;

static void candle_orientation(bool* flip_y, int8_t* lean_x) {
    gravity_xy_t g = gravity_get();
    float gx = g.valid ? g.gx : 0.0f;
    float gy = g.valid ? g.gy : -1.0f;

    if (!isfinite(gx)) {
        gx = 0.0f;
    }
    if (!isfinite(gy)) {
        gy = -1.0f;
    }

    // Y-axis controls only upright/upside-down. X tilt is intentionally ignored.
    if (gy<-0.7)
        *flip_y=true;
    else if (gy>0.7)
        *flip_y=false;       
    *lean_x = 0;
}

static uint8_t candle_root_locked_value(
    uint8_t panel_x,
    uint8_t panel_y,
    bool flip_y,
    uint32_t phase
) {
    int16_t from_root = flip_y ? (MATRIX_WIDTH - 1 - panel_x) : panel_x;
    if (from_root < 0) from_root = 0;
    if (from_root > MATRIX_WIDTH - 1) from_root = MATRIX_WIDTH - 1;

    uint8_t template_v = ((uint16_t)from_root * 255 + (MATRIX_WIDTH - 1) / 2) / (MATRIX_WIDTH - 1);

    int16_t center = ((int16_t)MATRIX_HEIGHT - 1) * 128;
    int16_t lateral = ((int16_t)panel_y * 255) - center;
    int16_t u16 = 128 + lateral / (MATRIX_HEIGHT - 1);
    if (u16 < 0) u16 = 0;
    if (u16 > 255) u16 = 255;

    int8_t wind_y = -110;
    uint8_t value = candle_flicker_wind_sharp(
        (uint8_t)u16,
        template_v,
        phase,
        0,
        wind_y,
        60,
        48
    );

    return value;
}

int candle_loop()
{
    delay(20);
    uint32_t now = millis();
    float dt = (now - last_ms) / 1000.0f;
    last_ms = now;

    t += dt * 4250.0f;

    static bool flip_y = false;
    int8_t lean_raw = 0;
    candle_orientation(&flip_y, &lean_raw);

    uint8_t hue = (uint8_t)((subpage_index * 20) % 256);

    for (uint8_t y = 0; y < MATRIX_WIDTH; y++) {
        for (uint8_t x = 0; x < MATRIX_HEIGHT; x++) {
            uint8_t value = candle_root_locked_value(y, x, flip_y, t);

            leds(y,MATRIX_HEIGHT-x-1) = candle_colorize(value, hue);
        }
    }

    FastLED.show();
    return 0;
}

int setup_candle(){
    brightness_max=10;
    FastLED.setBrightness(10);

    int err = gravity_sensor_start();
    if (err != 0) {
        Serial.println("mpu start failed");
    }
    
    if (mem_subindex3<0)
        mem_subindex3=load_config_ns("candle", "candle_index");
    subpage_index=mem_subindex3;
    
    return 0;

}

int unload_candle(){
    mem_subindex3=subpage_index;
    save_config_ns("candle", "candle_index", subpage_index);
    gravity_sensor_sleep();
    return 0;
}
